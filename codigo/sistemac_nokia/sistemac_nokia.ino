#include <SPI.h>
#include <Adafruit_GFX.h>
#include <Adafruit_PCD8544.h>

// Software SPI (slower updates, more flexible pin options):
// pin 7 - Serial clock out (SCLK)
// pin 6 - Serial data out (DIN)
// pin 5 - Data/Command select (D/C)
// pin 4 - LCD chip select (CS)
// pin 3 - LCD reset (RST)
Adafruit_PCD8544 display = Adafruit_PCD8544(7, 6, 5, 4, 3);
 // 'alejo_mono80x48'
const unsigned char alejo [] PROGMEM = {
  0x00, 0x00, 0x00, 0x00, 0x00, 0x00, 0x00, 0x00, 0x00, 0x00, 0x00, 0x00, 0x00, 0x00, 0x00, 0x00, 
  0x00, 0x00, 0x00, 0x00, 0x00, 0x00, 0x00, 0x00, 0x00, 0x00, 0x00, 0x00, 0x00, 0x00, 0x00, 0x00, 
  0x00, 0x00, 0x00, 0x00, 0x00, 0x00, 0x00, 0x00, 0x00, 0x00, 0x00, 0x00, 0x00, 0x00, 0x00, 0x00, 
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  0x00, 0x00, 0x00, 0x00, 0x00, 0x00, 0x00, 0x00, 0x00, 0x00, 0x00, 0x00, 0x00, 0x00, 0x00, 0x00
};

const unsigned char tempIco16x32 [] PROGMEM = {
  0x00, 0x00, 0x03, 0xe0, 0x07, 0xf0, 0x06, 0x70, 0x06, 0x30, 0x06, 0x30, 0x07, 0xb0, 0x07, 0xb0, 
  0x07, 0xb0, 0x07, 0xb8, 0x07, 0xb8, 0x07, 0xb0, 0x07, 0xb8, 0x07, 0xb8, 0x07, 0xb0, 0x07, 0xb8, 
  0x07, 0xb8, 0x07, 0xb0, 0x07, 0xb0, 0x07, 0xb0, 0x07, 0xb0, 0x0f, 0xb0, 0x1f, 0xf8, 0x1f, 0xf8, 
  0x1f, 0xf8, 0x1f, 0xf8, 0x1f, 0xf8, 0x1f, 0xf8, 0x0f, 0xf0, 0x07, 0xe0, 0x00, 0x00, 0x00, 0x00
};

int valor=0;
float mv_sensor=0;
float c_sensor=0;
int ledPin = 8;
int valorsensor = 0;
volatile int tempconfig = 30; //temperatura configurada

const int arribaPin = A1;
const int abajoPin = A2;

void setup(){
  Serial.begin(9600);
  display.begin();
  display.setContrast(60);
  display.clearDisplay();
  display.drawBitmap(2, 0,  alejo, 80, 48, 1);
  display.display();
  delay(2000);
  pinMode(ledPin, OUTPUT);
  pinMode(arribaPin, INPUT);
  pinMode(abajoPin, INPUT);
}

void loop(){
  valor = analogRead(A0);
  mv_sensor = (valor / 1024.0) * 5000;
  c_sensor= mv_sensor/10;
  Serial.println(c_sensor);
  imprimir();
  if (c_sensor>tempconfig){
    digitalWrite(ledPin, HIGH);
  } else {
    digitalWrite(ledPin, LOW);
  }
  for (int i=0;i<5;i++){
    lecturaBotones();
    delay(200);
  }
}


void lecturaBotones(){
  if (digitalRead(arribaPin)==LOW && tempconfig<=1000){
    tempconfig++;
    imprimir();
    Serial.println(tempconfig);
  }
  if (digitalRead(abajoPin)==LOW && tempconfig>=0){
    tempconfig--;
    Serial.println(tempconfig);
    imprimir();
  }
}

void imprimir(){
  display.clearDisplay();
  display.drawBitmap(0, 16,  tempIco16x32, 16, 32, 1);
  display.display();
  display.setTextSize(1);
  display.setTextColor(BLACK);
  display.setCursor(0,0);
  display.print("Temperatura:");
  display.setCursor(72,0);
  display.print(tempconfig);
  display.drawCircle(72, 29, 2, BLACK);
  display.setCursor(76,27);
  display.print("C");
  display.setTextSize(2);
  display.setCursor(20,20);
  display.println(c_sensor,1);
  display.display();
}
